## conf/layer.conf
```bitbake
# We have a conf and classes directory, add to BBPATH
BBPATH .= ":${LAYERDIR}"

# We have a packages directory, add to BBFILES
BBFILES += "${LAYERDIR}/recipes-*/*/*.bb ${LAYERDIR}/recipes-*/*/*.bbappend"

BBFILE_COLLECTIONS += "gstreamer1.0"
BBFILE_PATTERN_gstreamer1.0 := "^${LAYERDIR}/"
BBFILE_PRIORITY_gstreamer1.0 = "10"

LAYERVERSION_gstreamer1.0 = "12"

# This depends on https://github.com/Freescale/meta-fsl-arm (branch krogoth)
LAYERDEPENDS_gstreamer1.0_imx = "fsl-arm"
```
